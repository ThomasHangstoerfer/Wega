## buildroot_packages/button-handler/Config.in
```kconfig
config BR2_PACKAGE_BUTTONHANDLER
	bool "GPIO button-handler"
	help
	  Userspace tool to manage events from buttons connected to GPIOs
```

## buildroot_packages/hdc1008/Config.in
```kconfig
config BR2_PACKAGE_HDC1008
	bool "hdc1008"
	depends on BR2_TOOLCHAIN_HAS_THREADS # zeromq
	help
	  Userspace tool to communicate with a hdc1008-sensor via i2c
```
